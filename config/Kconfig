## config/dts/bindings/behaviors/kobitokey,behavior-haptic-tick.yaml
```yaml
description: |
  Plays one haptic effect on the half it runs on.

  This exists so the central can reach the peripheral's motor. ZMK's split
  link can invoke a behavior on the other half by name, and that is the
  only channel available for it -- so the thing to be reached has to be a
  behavior, even though it is never bound to a key.

  The single parameter is the DRV2605 effect number.

compatible: "kobitokey,behavior-haptic-tick"

include: one_param.yaml
```

## config/dts/bindings/input/kobitokey,axis-scroll-cut.yaml
```yaml
description: KobitoKey axis scroll cut input processor

compatible: "kobitokey,axis-scroll-cut"

properties:
  "#input-processor-cells":
    type: int
    required: true
    const: 0
    description: Number of cells in an input processor specifier.

  track-remainders:
    type: boolean
    description: Track fractional/remainder movement across input events.

  threshold:
    type: int
    default: 8
    description: Movement amount required to emit one scroll step.

  tan-threshold-per-mille:
    type: int
    default: 700
    description: Tangent threshold in per mille. 700 is about tan(35deg).

  invert-h:
    type: boolean
    description: Invert horizontal scroll direction.

  invert-v:
    type: boolean
    description: Invert vertical scroll direction.
```

## config/dts/bindings/input/kobitokey,fold-sense.yaml
```yaml
description: KobitoKey fold-state input

compatible: "kobitokey,fold-sense"

properties:
  gpios:
    type: phandle-array
    required: true
    description: GPIO connected to the level-shifted Hall sensor output
```

## config/dts/bindings/input/kobitokey,vbus-sense.yaml
```yaml
description: KobitoKey VBUS sense input

compatible: "kobitokey,vbus-sense"

include: base.yaml

properties:
  gpios:
    type: phandle-array
    required: true
    description: GPIO connected to the VBUS voltage divider
```

## config/dts/bindings/input/kobitokey.haptic-local-input.yaml
```yaml
description: KobitoKey right haptic input processor

compatible: "kobitokey,input-processor-haptic-right"

properties:
  "#input-processor-cells":
    type: int
    required: true

  track-remainders:
    type: boolean
    required: false
```

## config/west.yml
```yaml
manifest:
  remotes:
    - name: zmkfirmware
      url-base: https://github.com/zmkfirmware
    - name: juichi50iii
      url-base: https://github.com/juichi50iii
    - name: zettaface
      url-base: https://github.com/zettaface
    - name: caksoylar
      url-base: https://github.com/caksoylar

  projects:
    - name: zmk
      remote: zmkfirmware
      revision: v0.3
      import: app/west.yml

    - name: zmk-driver-paw3222
      remote: juichi50iii
      revision: main

    # Arrow-torabo
    - name: zmk-input-processor-keybind
      remote: zettaface
      revision: main

    # LED
    - name: zmk-rgbled-widget
      remote: juichi50iii
      revision: 1c008eb4484cbfd8bc3bb9d9b8ae0f8523483409

    #　Axis-lock
    - name: zmk-axis-lock
      remote: juichi50iii
      revision: main

    # nurunuru
    - name: zmk-scroll-nurunuru
      remote: juichi50iii
      revision: 8940b3af0547811c9d30682700dbf3cb14a5b762

  self:
    path: config
```
